## CMakeLists.txt
```
cmake_minimum_required(VERSION 3.20.0)

set(CMAKE_EXPORT_COMPILE_COMMANDS ON)
find_package(Zephyr REQUIRED HINTS $ENV{ZEPHYR_BASE})
project(multi_board_logger_app LANGUAGES C)

target_sources(app PRIVATE src/main.c)
```

## Kconfig
```
source "subsys/logging/Kconfig.template.log_config"
```

## prj.conf
```kconfig
# Enable logging subsystem
CONFIG_LOG=y

# Set default log level (0=none, 1=err, 2=warn, 3=info, 4=debug)
CONFIG_LOG_DEFAULT_LEVEL=3

# Enable your preferred logging backend (UART console is common)
CONFIG_UART_CONSOLE=y
CONFIG_SERIAL=y
```

## src/main.c
```c
#include <zephyr/kernel.h>
#include <zephyr/sys/printk.h>

int main(void)
{
    printk("Hello, Zephyr!\n");
    return 0;
}
```

## include/main_state_machine.h
```c
#ifndef MAIN_STATE_MACHINE_H
#define MAIN_STATE_MACHINE_H

#include "main_state_machine_types.h"

void main_sm_init(main_sm_t * sm);
void main_sm_handle_t(main_sm_t * sm);
void main_sm_run(main_sm_t * sm);

#endif
```

## include/main_state_machine_types.h
```c
#ifndef MAIN_STATE_MACHINE_TYPES_H
#define MAIN_STATE_MACHINE_TYPES_H

typedef struct main_sm_context_t main_sm_context_t;

typedef enum main_sm_state_t{
    MAIN_SM_STATE_INIT,
    MAIN_SM_STATE_TAKING_READINGS,
    MAIN_SM_STATE_CRITICAL_ERROR,
    MAIN_SM_STATE_NUM_STATES
} main_sm_state_t;

typedef enum main_sm_event_t{
    MAIN_SM_EVENT_START,
    MAIN_SM_EVENT_STOP,
    MAIN_SM_EVENT_ERROR
} main_sm_event_t;

typedef struct main_sm_t{
    main_sm_state_t current_state;
    main_sm_event_t event;
    main_sm_context_t * context;
} main_sm_t;

#endif
```
